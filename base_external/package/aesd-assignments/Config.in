## base_external/package/aesd-assignments/Config.in
```kconfig
config BR2_PACKAGE_AESD_ASSIGNMENTS
    bool "aesd-assignments"
    help
      Builds and installs AESD assignments finder application and scripts.
```
